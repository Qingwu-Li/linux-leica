## Documentation/devicetree/bindings/iio/proximity/semtech,sx9370.yaml
```yaml
# SPDX-License-Identifier: (GPL-2.0 OR BSD-2-Clause)
%YAML 1.2
---
$id: http://devicetree.org/schemas/iio/proximity/semtech,sx9370.yaml#
$schema: http://devicetree.org/meta-schemas/core.yaml#

title: Semtech SX9370 series SAR proximity sensor

maintainers:
  - Jonathan Cameron <jic23@kernel.org>

description: |
  Semtech SX9370 series capacitive SAR proximity sensor with
  up to 8 channels, supporting multiple proximity detection
  thresholds per channel.

properties:
  compatible:
    enum:
      - semtech,sx9370
      - semtech,sx9373
      - semtech,sx9374
      - semtech,sx9376

  reg:
    maxItems: 1

  interrupts:
    maxItems: 1
    description: |
      Generated by device to announce preceding read request has finished
      and data is available or that a close/far proximity event has happened.

  Semtech,reg-init:
    $ref: /schemas/types.yaml#/definitions/uint32-matrix
    description: |
      Register initialization configuration. Each entry contains a register
      address followed by its initialization value. Applied after default
      register configuration.
    items:
      items:
        - description: Register address
        - description: Register value

required:
  - compatible
  - reg

additionalProperties: false

examples:
  - |
    #include <dt-bindings/interrupt-controller/irq.h>
    i2c {
        #address-cells = <1>;
        #size-cells = <0>;
        proximity@2c {
            compatible = "semtech,sx9370";
            reg = <0x2c>;
            interrupt-parent = <&gpio1>;
            interrupts = <17 IRQ_TYPE_LEVEL_LOW>;
            Semtech,reg-init = <
                0x8098 0x8040
                0x80B8 0x5A2A
                0x80D8 0x2828
                0x80F8 0x4747
            >;
        };
    };
```
